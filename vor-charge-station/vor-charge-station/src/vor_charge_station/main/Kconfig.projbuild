## vor-charge-station/vor-charge-station/src/vor_charge_station/main/Kconfig.projbuild
```kconfig
menu "IR RMT Configuration"
    choice IR_PROTOCOL
        prompt "Infrared Protocol"
        default IR_PROTOCOL_NEC
        help
            Choose the IR protocol used in the example.

        config IR_PROTOCOL_NEC
            bool "NEC"
            help
                NEC is a kind of Pulse Distance Protocol.
                It uses ASK modulation and pulse distance encoding with a carrier frequency of 38 kHz.

        config IR_PROTOCOL_RC5
            bool "RC5"
            help
                The RC5 protocol was introduced by Philips.
                It uses ASK modulation and Manchester encoding with carrier frequency fixed at 36 kHz.

    endchoice

    config RMT_TX_GPIO
        int "RMT TX GPIO"
        default 18
        help
            Set the GPIO number used for transmitting the RMT signal.

    config RMT_RX_GPIO
        int "RMT RX GPIO"
        default 19
        help
            Set the GPIO number used for receiving the RMT signal.

    config RMT_TX_CHANNEL
        int "RMT TX Channel Number"
        default 0
        help
            Set the RMT TX channel number.

    config RMT_RX_CHANNEL
        int "RMT RX Channel Number"
        default 4 if IDF_TARGET_ESP32S3
        default 2
        help
            Set the RMT RX channel number.
endmenu


menu "ACS Configuration"
    config ACS_NUMBER_NAME
        int "ACS_NUMBER"
        default 1
        help
            Set the number of ACS (from 001 to 006), it can be another value (7,8,9...).
endmenu
```
